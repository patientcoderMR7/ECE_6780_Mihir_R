# file: MR_6780_Lab_03.ioc
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Mcu.Family=STM32F0
Mcu.Name=STM32F072R(8-B)Tx
Mcu.Package=LQFP64
ProjectManager.HeapSize=0x200
ProjectManager.StackSize=0x400
ProjectManager.TargetToolchain=MDK-ARM V5.32
board=custom

// file: main.c
/* USER CODE BEGIN Header */
/**
  ******************************************************************************
  * @file           : main.c
  * @brief          : Main program body
  ******************************************************************************
  * @attention
  *
  * Copyright (c) 2024 STMicroelectronics.
  * All rights reserved.
  *
  * This software is licensed under terms that can be found in the LICENSE file
  * in the root directory of this software component.
  * If no LICENSE file comes with this software, it is provided AS-IS.
  *
  ******************************************************************************
  */
/* USER CODE END Header */
#include "main.h"

void SystemClock_Config(void);

//create interrupt function
void TIM2_IRQHandler(void){

	GPIOC->ODR ^= ((1 << 8) | (1 << 9));
	TIM2->SR = 0x00;
}

//Function for Alternate conguration for pins 6 and 7 (blue and red leds - timer3 channels )
void GPIO_Config(void) {
    RCC->AHBENR |= RCC_AHBENR_GPIOCEN; // Enable GPIOC clock

    // Configure PC6 (red LED) and PC7 (blue LED) as alternate function mode
    GPIOC->MODER &= ~(GPIO_MODER_MODER6_Msk | GPIO_MODER_MODER7_Msk); // Clear bits
    GPIOC->MODER |= (GPIO_MODER_MODER6_1 | GPIO_MODER_MODER7_1); // Set alternate function mode (AF)

    // Configure PC6 and PC7 for alternate function AF0 (TIM3_CH1 and TIM3_CH2)
    GPIOC->AFR[0] &= ~((0xF << GPIO_AFRL_AFRL6_Pos) | (0xF << GPIO_AFRL_AFRL7_Pos)); // Clear bits
    GPIOC->AFR[0] |= (0 << GPIO_AFRL_AFRL6_Pos) | (0 << GPIO_AFRL_AFRL7_Pos); // Set AF0

    // Configure PC6 and PC7 as push-pull outputs
    GPIOC->OTYPER &= ~(GPIO_OTYPER_OT_6 | GPIO_OTYPER_OT_7); // Push-pull mode

    // Configure PC6 and PC7 as low-speed outputs
    GPIOC->OSPEEDR &= ~(GPIO_OSPEEDR_OSPEEDR6_Msk | GPIO_OSPEEDR_OSPEEDR7_Msk); // Clear bits

    // Configure PC6 and PC7 with no pull-up or pull-down
    GPIOC->PUPDR &= ~(GPIO_PUPDR_PUPDR6_Msk | GPIO_PUPDR_PUPDR7_Msk); // Clear bits
}

//Function for Part 2 - Timer 3 and PWM
void TIM_Config(void) {
    RCC->APB1ENR |= RCC_APB1ENR_TIM3EN; // Enable Timer 3 clock

    // Set Timer 3's prescaler and auto-reload register (ARR) for 800 Hz PWM frequency
    TIM3->PSC = 9; // Prescaler value (PSC + 1)
    TIM3->ARR = 1000; // Auto-reload value (period)

    // Configure Timer 3 channel 1 for PWM Mode 2
    TIM3->CCMR1 &= ~(TIM_CCMR1_OC1M_Msk); // Clear bits
    TIM3->CCMR1 |= (TIM_CCMR1_OC1M_1 | TIM_CCMR1_OC1M_2); // PWM Mode 2

    // Configure Timer 3 channel 2 for PWM Mode 1
    TIM3->CCMR1 &= ~(TIM_CCMR1_OC2M_Msk); // Clear bits
    TIM3->CCMR1 |= (TIM_CCMR1_OC2M_0 | TIM_CCMR1_OC2M_1); // PWM Mode 1

    // Enable output for Timer 3 channel 1 and channel 2
    TIM3->CCER |= (TIM_CCER_CC1E | TIM_CCER_CC2E);

    // Set initial capture/compare values (CCR) for both channels
    TIM3->CCR1 = 20; // 20% duty cycle for channel 1
    TIM3->CCR2 = 20; // 20% duty cycle for channel 2

    // Enable Timer 3
    TIM3->CR1 |= TIM_CR1_CEN;
}

int main(void)
{

  /* MCU Configuration--------------------------------------------------------*/

  /* Reset of all peripherals, Initializes the Flash interface and the Systick. */
  HAL_Init();

  /* USER CODE BEGIN Init */
 RCC->APB1ENR |= RCC_APB1ENR_TIM2EN;
	RCC->AHBENR |= RCC_AHBENR_GPIOCEN;

	// Clear the bits for PC6, PC7, PC8 and PC9
  GPIOC->MODER &= ~(3 << 12);
  GPIOC->MODER &= ~(3 << 14);
  GPIOC->MODER &= ~(3 << 16);
  GPIOC->MODER &= ~(3 << 18);
  // Setting PC6, PC7, PC8 and PC9 to General-Purpose Output Mode
  GPIOC->MODER |= (1 << 12) | (1 << 14) | (1 << 16) | (1 << 18);
  // Setting PC6, PC7, PC8 and PC9 to Push-Pull Output Type
  GPIOC->OTYPER &= ~(1 << 6);
  GPIOC->OTYPER &= ~(1 << 7);
  GPIOC->OTYPER &= ~(1 << 8);
  GPIOC->OTYPER &= ~(1 << 9);
  // Set PC6, PC7, PC8 and PC9 to Low Speed
  GPIOC->OSPEEDR &= ~(0 << 12);
  GPIOC->OSPEEDR &= ~(0 << 14);
  GPIOC->OSPEEDR &= ~(0 << 16);
  GPIOC->OSPEEDR &= ~(0 << 18);
  // Clear the bits for PC6, PC7, PC8 and PC9
  // This also sets the pull-up/pull-down resistors to no pull-up/pull-down since the bits are 00
  GPIOC->PUPDR &= ~(3 << 12);
  GPIOC->PUPDR &= ~(3 << 14);
  GPIOC->PUPDR &= ~(3 << 16);
  GPIOC->PUPDR &= ~(3 << 18);

	//set green to high for toggling
	GPIOC->ODR |= (1 << 9);
	//timer 2 set psc & arr values for 4Hz
	TIM2->PSC = 7999;
	TIM2->ARR = 250;

	//enable timer interrupt
	TIM2->DIER = (1 << 0);
	//enable timer 2
	TIM2->CR1 |= (1 << 0);
	//enable NVIC
	NVIC_EnableIRQ(TIM2_IRQn);

	//Part 2
	GPIO_Config();
  	TIM_Config();
  /* USER CODE END Init */

  /* Configure the system clock */
  SystemClock_Config();

  /* Initialize all configured peripherals */

  /* Infinite loop */
  while (1)
  {

  }
}

void SystemClock_Config(void)
{
  RCC_OscInitTypeDef RCC_OscInitStruct = {0};
  RCC_ClkInitTypeDef RCC_ClkInitStruct = {0};

  /** Initializes the RCC Oscillators according to the specified parameters
  * in the RCC_OscInitTypeDef structure.
  */
  RCC_OscInitStruct.OscillatorType = RCC_OSCILLATORTYPE_HSI;
  RCC_OscInitStruct.HSIState = RCC_HSI_ON;
  RCC_OscInitStruct.HSICalibrationValue = RCC_HSICALIBRATION_DEFAULT;
  RCC_OscInitStruct.PLL.PLLState = RCC_PLL_NONE;
  if (HAL_RCC_OscConfig(&RCC_OscInitStruct) != HAL_OK)
  {
    Error_Handler();
  }

  /** Initializes the CPU, AHB and APB buses clocks
  */
  RCC_ClkInitStruct.ClockType = RCC_CLOCKTYPE_HCLK|RCC_CLOCKTYPE_SYSCLK
                              |RCC_CLOCKTYPE_PCLK1;
  RCC_ClkInitStruct.SYSCLKSource = RCC_SYSCLKSOURCE_HSI;
  RCC_ClkInitStruct.AHBCLKDivider = RCC_SYSCLK_DIV1;
  RCC_ClkInitStruct.APB1CLKDivider = RCC_HCLK_DIV1;

  if (HAL_RCC_ClockConfig(&RCC_ClkInitStruct, FLASH_LATENCY_0) != HAL_OK)
  {
    Error_Handler();
  }
}

void Error_Handler(void)
{
  __disable_irq();
  while (1)
  {
  }
}
